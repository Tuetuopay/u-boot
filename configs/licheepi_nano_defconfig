## configs/licheepi_nano_defconfig
```kconfig
CONFIG_ARM=y
CONFIG_ARCH_SUNXI=y
CONFIG_SYS_TEXT_BASE=0x81700000
CONFIG_MACH_SUNIV=y
CONFIG_DRAM_CLK=156
CONFIG_DRAM_ZQ=0
# CONFIG_VIDEO_SUNXI is not set
CONFIG_BOOTCOMMAND="fatload mmc 0:1 $kernel_addr_r zImage; fatload mmc 0:1 $fdt_addr_r suniv-f1c100s-licheepi-nano.dtb; setenv bootargs console=ttyS0,115200 root=/dev/mmcblk0p2 rootwait; bootz $kernel_addr_r - $fdt_addr_r"
CONFIG_DEFAULT_DEVICE_TREE="suniv-f1c100s-licheepi-nano"
CONFIG_SPL=y
# CONFIG_SPL_DM_SERIAL is not set
```
